## components/epdiy/Kconfig
```kconfig
menu "epdiy (vendored, reflbo patches)"

    config EPD_LUT_IN_PSRAM
        bool "Waveform LUT in PSRAM"
        default n
        help
            reflbo patch P5: the 64 KB conversion LUT in PSRAM instead of internal RAM. Slower, but it
            leaves internal RAM to Wi-Fi. Without it, a failed internal allocation falls back to PSRAM.

endmenu
```
